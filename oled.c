#include "oled.h"
#include "delay.h"

#define OLED_WIDTH          128
#define OLED_PAGE_COUNT     8
#define OLED_COLUMN_OFFSET  2

#define OLED_SCLK_HIGH()    (GPIOB->BSRR = GPIO_Pin_5)
#define OLED_SCLK_LOW()     (GPIOB->BRR  = GPIO_Pin_5)
#define OLED_MOSI_HIGH()    (GPIOB->BSRR = GPIO_Pin_4)
#define OLED_MOSI_LOW()     (GPIOB->BRR  = GPIO_Pin_4)
#define OLED_RES_HIGH()     (GPIOB->BSRR = GPIO_Pin_3)
#define OLED_RES_LOW()      (GPIOB->BRR  = GPIO_Pin_3)
#define OLED_DC_HIGH()      (GPIOA->BSRR = GPIO_Pin_15)
#define OLED_DC_LOW()       (GPIOA->BRR  = GPIO_Pin_15)

enum {
    HAN_DI = 0,
    HAN_LIU,
    HAN_ZU,
    HAN_ZHAN,
    HAN_KONG,
    HAN_BI,
    HAN_BIAN,
    HAN_MA,
    HAN_QI,
    HAN_ZUO,
    HAN_YOU,
    HAN_LUN,
    HAN_ZHUANG,
    HAN_TAI,
    HAN_ZHI,
    HAN_XIAN,
    HAN_WAN,
    HAN_DAO
};

static uint8_t g_oled_buffer[OLED_PAGE_COUNT][OLED_WIDTH];
static uint8_t g_refresh_page = 0;

/* 16x16 Chinese glyphs: 第六组占空比编码器左右轮状态直线弯道 */
static const uint8_t CHINESE_FONT[18][32] = {
    {0x08,0x04,0x93,0x92,0x96,0x9A,0x92,0xFA,0x94,0x93,0x92,0x96,0xFA,0x02,0x02,0x00,
     0x40,0x40,0x47,0x24,0x24,0x14,0x0C,0xFF,0x04,0x04,0x24,0x44,0x24,0x1C,0x00,0x00},
    {0x20,0x20,0x20,0x20,0x20,0x20,0x21,0x22,0x2C,0x20,0x20,0x20,0x20,0x20,0x20,0x00,
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     0x00,0x40,0x20,0x1F,0x20,0x40,0x5F,0x4A,0x4A,0x4A,0x4A,0x4A,0x5F,0x40,0x40,0x00}
};

static const uint8_t FONT_SPACE[5] = {0,0,0,0,0};
static const uint8_t FONT_COLON[5] = {0x00,0x36,0x36,0x00,0x00};
static const uint8_t FONT_MINUS[5] = {0x08,0x08,0x08,0x08,0x08};
static const uint8_t FONT_SLASH[5] = {0x20,0x10,0x08,0x04,0x02};
static const uint8_t FONT_0[5] = {0x3E,0x51,0x49,0x45,0x3E};
static const uint8_t FONT_1[5] = {0x00,0x42,0x7F,0x40,0x00};
static const uint8_t FONT_2[5] = {0x42,0x61,0x51,0x49,0x46};
static const uint8_t FONT_3[5] = {0x21,0x41,0x45,0x4B,0x31};
static const uint8_t FONT_4[5] = {0x18,0x14,0x12,0x7F,0x10};
static const uint8_t FONT_5[5] = {0x27,0x45,0x45,0x45,0x39};
static const uint8_t FONT_6[5] = {0x3C,0x4A,0x49,0x49,0x30};
static const uint8_t FONT_7[5] = {0x01,0x71,0x09,0x05,0x03};
static const uint8_t FONT_8[5] = {0x36,0x49,0x49,0x49,0x36};
static const uint8_t FONT_9[5] = {0x06,0x49,0x49,0x29,0x1E};
static const uint8_t FONT_L[5] = {0x7F,0x40,0x40,0x40,0x40};
static const uint8_t FONT_M[5] = {0x7F,0x02,0x0C,0x02,0x7F};
static const uint8_t FONT_P[5] = {0x7F,0x09,0x09,0x09,0x06};
static const uint8_t FONT_R[5] = {0x7F,0x09,0x19,0x29,0x46};
static const uint8_t FONT_W[5] = {0x3F,0x40,0x38,0x40,0x3F};

static void OLED_WriteByte(uint8_t data, uint8_t is_data)
{
    uint8_t i;

    if (is_data) OLED_DC_HIGH();
    else OLED_DC_LOW();

    for (i = 0; i < 8; i++) {
        OLED_SCLK_LOW();
        if (data & 0x80) OLED_MOSI_HIGH();
        else OLED_MOSI_LOW();
        OLED_SCLK_HIGH();
        data <<= 1;
    }
    OLED_SCLK_LOW();
}

static void OLED_WriteCommand(uint8_t command)
{
    OLED_WriteByte(command, 0);
}

static void OLED_SetPosition(uint8_t page, uint8_t column)
{
    uint8_t actual_column = (uint8_t)(column + OLED_COLUMN_OFFSET);

    OLED_WriteCommand((uint8_t)(0xB0U + page));
    OLED_WriteCommand((uint8_t)(0x10U | (actual_column >> 4)));
    OLED_WriteCommand((uint8_t)(actual_column & 0x0FU));
}

static void OLED_ClearBuffer(void)
{
    uint8_t page;
    uint8_t column;

    for (page = 0; page < OLED_PAGE_COUNT; page++) {
        for (column = 0; column < OLED_WIDTH; column++) {
            g_oled_buffer[page][column] = 0;
        }
    }
}

static const uint8_t *OLED_GetAsciiFont(char ch)
{
    switch (ch) {
        case ':': return FONT_COLON;
        case '-': return FONT_MINUS;
        case '/': return FONT_SLASH;
        case '0': return FONT_0;
        case '1': return FONT_1;
        case '2': return FONT_2;
        case '3': return FONT_3;
        case '4': return FONT_4;
        case '5': return FONT_5;
        case '6': return FONT_6;
        case '7': return FONT_7;
        case '8': return FONT_8;
        case '9': return FONT_9;
        case 'L': return FONT_L;
        case 'M': return FONT_M;
        case 'P': return FONT_P;
        case 'R': return FONT_R;
        case 'W': return FONT_W;
        default: return FONT_SPACE;
    }
}

static uint8_t OLED_DrawChar(uint8_t x, uint8_t y, char ch)
{
    const uint8_t *font = OLED_GetAsciiFont(ch);
    uint8_t page = (uint8_t)(y >> 3);
    uint8_t i;

    if (page >= OLED_PAGE_COUNT || x > OLED_WIDTH - 6) return x;

    for (i = 0; i < 5; i++) {
        g_oled_buffer[page][x + i] = font[i];
    }
    g_oled_buffer[page][x + 5] = 0;
    return (uint8_t)(x + 6);
}

static uint8_t OLED_DrawText(uint8_t x, uint8_t y, const char *text)
{
    while (*text != '\0' && x <= OLED_WIDTH - 6) {
        x = OLED_DrawChar(x, y, *text++);
    }
    return x;
}

static uint8_t OLED_DrawInt(uint8_t x, uint8_t y, int32_t value)
{
    char digits[4];
    uint8_t count = 0;

    if (value > 999) value = 999;
    if (value < -999) value = -999;

    if (value < 0) {
        x = OLED_DrawChar(x, y, '-');
        value = -value;
    }

    do {
        digits[count++] = (char)('0' + (value % 10));
        value /= 10;
    } while (value != 0 && count < sizeof(digits));

    while (count > 0) {
        x = OLED_DrawChar(x, y, digits[--count]);
    }
    return x;
}

static void OLED_DrawPair(uint8_t x, uint8_t y,
                          int32_t left, int32_t right)
{
    x = OLED_DrawInt(x, y, left);
    x = OLED_DrawChar(x, y, '/');
    OLED_DrawInt(x, y, right);
}

static void OLED_DrawChinese(uint8_t x, uint8_t y, uint8_t index)
{
    uint8_t page = (uint8_t)(y >> 3);
    uint8_t i;

    if (index >= 18 || page >= OLED_PAGE_COUNT - 1 ||
        x > OLED_WIDTH - 16) {
        return;
    }

    for (i = 0; i < 16; i++) {
        g_oled_buffer[page][x + i] = CHINESE_FONT[index][i];
        g_oled_buffer[page + 1][x + i] = CHINESE_FONT[index][16 + i];
    }
}

void OLED_Init(void)
{
    GPIO_InitTypeDef gpio;

    RCC_APB2PeriphClockCmd(RCC_APB2Periph_GPIOA |
                           RCC_APB2Periph_GPIOB |
                           RCC_APB2Periph_AFIO, ENABLE);

    /* PB3/PB4/PA15 are JTAG pins; disable JTAG but keep SWD enabled. */
    GPIO_PinRemapConfig(GPIO_Remap_SWJ_JTAGDisable, ENABLE);

    GPIO_StructInit(&gpio);
    gpio.GPIO_Mode = GPIO_Mode_Out_PP;
    gpio.GPIO_Speed = GPIO_Speed_50MHz;
    gpio.GPIO_Pin = GPIO_Pin_3 | GPIO_Pin_4 | GPIO_Pin_5;
    GPIO_Init(GPIOB, &gpio);

    gpio.GPIO_Pin = GPIO_Pin_15;
    GPIO_Init(GPIOA, &gpio);

    OLED_SCLK_LOW();
    OLED_MOSI_LOW();
    OLED_DC_LOW();

    OLED_RES_LOW();
    Delay_ms(20);
    OLED_RES_HIGH();
    Delay_ms(20);

    OLED_WriteCommand(0xAE);
    OLED_WriteCommand(0x02);
    OLED_WriteCommand(0x10);
    OLED_WriteCommand(0x40);
    OLED_WriteCommand(0xB0);
    OLED_WriteCommand(0x81);
    OLED_WriteCommand(0x80);
    OLED_WriteCommand(0xA1);
    OLED_WriteCommand(0xA6);
    OLED_WriteCommand(0xA8);
    OLED_WriteCommand(0x3F);
    /* SSD1306 charge pump command; ignored by SH1106. */
    OLED_WriteCommand(0x8D);
    OLED_WriteCommand(0x14);
    /* SH1106 DC-DC command; ignored by SSD1306. */
    OLED_WriteCommand(0xAD);
    OLED_WriteCommand(0x8B);
    OLED_WriteCommand(0x30);
    OLED_WriteCommand(0xC8);
    OLED_WriteCommand(0xD3);
    OLED_WriteCommand(0x00);
    OLED_WriteCommand(0xD5);
    OLED_WriteCommand(0x80);
    OLED_WriteCommand(0xD9);
    OLED_WriteCommand(0x1F);
    OLED_WriteCommand(0xDA);
    OLED_WriteCommand(0x12);
    OLED_WriteCommand(0xDB);
    OLED_WriteCommand(0x40);
    OLED_WriteCommand(0xA4);
    OLED_WriteCommand(0xAF);

    /* Startup hardware test: all pixels on for 500 ms. */
    OLED_WriteCommand(0xA5);
    Delay_ms(500);
    OLED_WriteCommand(0xA4);

    OLED_ClearBuffer();
    OLED_Refresh();
}

void OLED_Refresh(void)
{
    uint8_t page;
    uint8_t column;

    for (page = 0; page < OLED_PAGE_COUNT; page++) {
        OLED_SetPosition(page, 0);
        for (column = 0; column < OLED_WIDTH; column++) {
            OLED_WriteByte(g_oled_buffer[page][column], 1);
        }
    }
}

void OLED_RefreshStep(void)
{
    uint8_t column;

    OLED_SetPosition(g_refresh_page, 0);
    for (column = 0; column < OLED_WIDTH; column++) {
        OLED_WriteByte(g_oled_buffer[g_refresh_page][column], 1);
    }

    g_refresh_page++;
    if (g_refresh_page >= OLED_PAGE_COUNT) {
        g_refresh_page = 0;
    }
}

void OLED_UpdateDashboard(int16_t motor_left,
                          int16_t motor_right,
                          int32_t encoder_left,
                          int32_t encoder_right,
                          uint8_t curve_mode)
{
    static int32_t last_encoder_left = 0;
    static int32_t last_encoder_right = 0;
    int32_t speed_left = encoder_left - last_encoder_left;
    int32_t speed_right = encoder_right - last_encoder_right;
    int16_t duty_left = motor_left;
    int16_t duty_right = motor_right;

    last_encoder_left = encoder_left;
    last_encoder_right = encoder_right;

    if (duty_left < 0) duty_left = -duty_left;
    if (duty_right < 0) duty_right = -duty_right;

    OLED_ClearBuffer();

    /* Row 1: 第六组 PWM */
    OLED_DrawChinese(0, 0, HAN_DI);
    OLED_DrawChinese(16, 0, HAN_LIU);
    OLED_DrawChinese(32, 0, HAN_ZU);
    OLED_DrawText(50, 4, "PWM:");
    OLED_DrawPair(74, 4, duty_left, duty_right);

    /* Row 2: 编码器 total count */
    OLED_DrawChinese(0, 16, HAN_BIAN);
    OLED_DrawChinese(16, 16, HAN_MA);
    OLED_DrawChinese(32, 16, HAN_QI);
    OLED_DrawPair(52, 20, encoder_left % 1000,
                  encoder_right % 1000);

    /* Row 3: 左右轮 speed (encoder delta per display interval) */
    OLED_DrawChinese(0, 32, HAN_ZUO);
    OLED_DrawChinese(16, 32, HAN_YOU);
    OLED_DrawChinese(32, 32, HAN_LUN);
    OLED_DrawPair(52, 36, speed_left, speed_right);

    /* Row 4: 状态 直线/弯道 */
    OLED_DrawChinese(0, 48, HAN_ZHUANG);
    OLED_DrawChinese(16, 48, HAN_TAI);
    OLED_DrawChar(36, 52, ':');
    if (curve_mode) {
        OLED_DrawChinese(46, 48, HAN_WAN);
        OLED_DrawChinese(62, 48, HAN_DAO);
    } else {
        OLED_DrawChinese(46, 48, HAN_ZHI);
        OLED_DrawChinese(62, 48, HAN_XIAN);
    }
}
